## makoto-pet/firmware/main/Kconfig.projbuild
```kconfig
menu "Makoto Pet 配置"

config MAKOTO_WIFI_SSID
    string "Wi-Fi 名称 (SSID)"
    default ""
    help
        留空则开机后进入配网热点模式（热点名 Makoto-Pet-xxxx）。
        配网页面地址 http://192.168.4.1

config MAKOTO_WIFI_PASSWORD
    string "Wi-Fi 密码"
    default ""

config MAKOTO_SERVER_URI
    string "语音中枢 WebSocket 地址"
    default "ws://192.168.1.100:8765/ws/device"
    help
        例如 ws://192.168.1.100:8765/ws/device，IP 改成你电脑的局域网 IP。

config MAKOTO_VOLUME
    int "开机音量 (0-100)"
    range 0 100
    default 70

config MAKOTO_BOOT_PTT
    bool "BOOT 键按住说话"
    default y

config MAKOTO_BOOT_LONGPRESS_MS
    int "BOOT 长按唤醒 AI 的阈值 (毫秒)"
    range 500 10000
    default 3000
    help
        BOOT 键需要按住这么久才启动语音对话；短按不启动。
        在相机界面里，短按（小于这个值）会拍照，长按仍然进入语音对话。

config MAKOTO_ENABLE_WAKE_WORD
    bool "启用本地唤醒词 (esp-sr)"
    default n
    help
        需要 esp-sr 与 model 分区，体积较大。默认关闭，用 BOOT 键/屏幕按钮说话。

endmenu
```

## makoto-pet/firmware/sdkconfig.defaults
```kconfig
# 立创实战派 ESP32-S3 (N16R8)
CONFIG_IDF_TARGET="esp32s3"
CONFIG_ESPTOOLPY_FLASHSIZE_16MB=y
CONFIG_PARTITION_TABLE_CUSTOM=y
CONFIG_PARTITION_TABLE_CUSTOM_FILENAME="partitions.csv"

CONFIG_SPIRAM=y
CONFIG_SPIRAM_MODE_OCT=y
CONFIG_SPIRAM_SPEED_80M=y
CONFIG_ESP_DEFAULT_CPU_FREQ_MHZ_240=y
CONFIG_ESP32S3_INSTRUCTION_CACHE_32KB=y
CONFIG_ESP32S3_DATA_CACHE_64KB=y
CONFIG_ESP32S3_DATA_CACHE_LINE_64B=y

# LVGL
CONFIG_LV_COLOR_16_SWAP=y
CONFIG_LV_MEM_CUSTOM=y
CONFIG_LV_FONT_MONTSERRAT_16=y
CONFIG_LV_FONT_MONTSERRAT_24=y
CONFIG_LV_FONT_SIMSUN_16_CJK=y
CONFIG_LV_USE_ANIMIMG=n

# 音频/网络
CONFIG_FREERTOS_HZ=1000
CONFIG_ESP_MAIN_TASK_STACK_SIZE=8192
CONFIG_ESP_WIFI_STATIC_RX_BUFFER_NUM=16
CONFIG_ESP_WIFI_DYNAMIC_RX_BUFFER_NUM=64
CONFIG_ESP_WIFI_DYNAMIC_TX_BUFFER_NUM=64
CONFIG_LWIP_TCP_SND_BUF_DEFAULT=32768
CONFIG_LWIP_TCP_WND_DEFAULT=32768
CONFIG_MBEDTLS_DYNAMIC_BUFFER=y
CONFIG_ESP_TASK_WDT_TIMEOUT_S=15
CONFIG_LV_FONT_MONTSERRAT_14=y
CONFIG_LV_USE_KEYBOARD=y
CONFIG_LV_FONT_FMT_TXT_LARGE=y

# 摄像头用普通 DMA（官方例程路径）；8KB 缓冲在 app_main 启动早期预留
CONFIG_CAMERA_DMA_BUFFER_SIZE_MAX=8192
# CONFIG_CAMERA_PSRAM_DMA is not set

# 摄像头：Windowing 模式帧率更高（Subsample 读全 1600x1200，只有约 8fps）
# CONFIG_GC_SENSOR_WINDOWING_MODE is not set

# 摄像头：Subsample 大视野（推荐）
CONFIG_GC_SENSOR_SUBSAMPLE_MODE=y
```
